## zigbee/main/Kconfig.projbuild
```kconfig
menu "Airloom Wi-Fi"
    config AIRLOOM_WIFI_SSID
        string "Wi-Fi SSID"
        default ""
        help
            Stored in the local, Git-ignored sdkconfig. Never commit sdkconfig.
    config AIRLOOM_WIFI_PASSWORD
        string "Wi-Fi password"
        default ""
        help
            Stored in the local, Git-ignored sdkconfig. Never commit sdkconfig.
    config AIRLOOM_UPDATE_PASSWORD
        string "Firmware update password (12 to 64 printable ASCII characters)"
        default ""
        help
            Required for Web firmware uploads. Empty disables uploads.
            Stored only in the local sdkconfig and resulting firmware.
endmenu
```

## zigbee/sdkconfig.defaults
```kconfig
CONFIG_IDF_TARGET="esp32c6"
CONFIG_ESPTOOLPY_FLASHSIZE_4MB=y
CONFIG_ZB_ENABLED=y
CONFIG_ESP_CONSOLE_USB_SERIAL_JTAG=y
CONFIG_PARTITION_TABLE_CUSTOM=y
CONFIG_PARTITION_TABLE_CUSTOM_FILENAME="partitions.csv"
CONFIG_ESP_COEX_SW_COEXIST_ENABLE=y
CONFIG_ESP_SYSTEM_EVENT_TASK_STACK_SIZE=4096
```
